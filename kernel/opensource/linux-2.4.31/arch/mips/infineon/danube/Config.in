## kernel/opensource/linux-2.4.31/crypto/Config.in
```kconfig
#
# Cryptographic API Configuration
#
mainmenu_option next_comment
comment 'Cryptographic options'

if [ "$CONFIG_INET_AH" = "y" -o \
     "$CONFIG_INET_AH" = "m" -o \
     "$CONFIG_INET_ESP" = "y" -o \
     "$CONFIG_INET_ESP" = "m" -o \
     "$CONFIG_INET6_AH" = "y" -o \
     "$CONFIG_INET6_AH" = "m" -o \
     "$CONFIG_INET6_ESP" = "y" -o \
     "$CONFIG_INET6_ESP" = "m" ]; then
  define_bool CONFIG_CRYPTO y
else
  bool 'Cryptographic API' CONFIG_CRYPTO
fi

if [ "$CONFIG_CRYPTO" = "y" ]; then
	tristate       'Cryptodev (/dev/crypto) interface' CONFIG_CRYPTO_CRYPTODEV
  if [ "$CONFIG_INET_AH" = "y" -o \
       "$CONFIG_INET_AH" = "m" -o \
       "$CONFIG_INET_ESP" = "y" -o \
       "$CONFIG_INET_ESP" = "m" -o \
       "$CONFIG_INET6_AH" = "y" -o \
       "$CONFIG_INET6_AH" = "m" -o \
       "$CONFIG_INET6_ESP" = "y" -o \
       "$CONFIG_INET6_ESP" = "m" ]; then
    define_bool CONFIG_CRYPTO_HMAC y
  else
    bool           '  HMAC support' CONFIG_CRYPTO_HMAC
  fi
  tristate       '  NULL algorithms' CONFIG_CRYPTO_NULL
  tristate       '  MD4 digest algorithm' CONFIG_CRYPTO_MD4
  if [ "$CONFIG_INET_AH" = "y" -o \
       "$CONFIG_INET_AH" = "m" -o \
       "$CONFIG_INET_ESP" = "y" -o \
       "$CONFIG_INET_ESP" = "m" -o \
       "$CONFIG_INET6_AH" = "y" -o \
       "$CONFIG_INET6_AH" = "m" -o \
       "$CONFIG_INET6_ESP" = "y" -o \
       "$CONFIG_INET6_ESP" = "m" ]; then
    define_bool CONFIG_CRYPTO_MD5 y
  else
    tristate       '  MD5 digest algorithm' CONFIG_CRYPTO_MD5
  fi
  if [ "$CONFIG_INET_AH" = "y" -o \
       "$CONFIG_INET_AH" = "m" -o \
       "$CONFIG_INET_ESP" = "y" -o \
       "$CONFIG_INET_ESP" = "m" -o \
       "$CONFIG_INET6_AH" = "y" -o \
       "$CONFIG_INET6_AH" = "m" -o \
       "$CONFIG_INET6_ESP" = "y" -o \
       "$CONFIG_INET6_ESP" = "m" ]; then
    define_bool CONFIG_CRYPTO_SHA1 y
  else
    tristate       '  SHA1 digest algorithm' CONFIG_CRYPTO_SHA1
  fi
  tristate       '  SHA256 digest algorithm' CONFIG_CRYPTO_SHA256
  tristate       '  SHA384 and SHA512 digest algorithms' CONFIG_CRYPTO_SHA512
  tristate       '  Whirlpool digest algorithms' CONFIG_CRYPTO_WP512
  if [ "$CONFIG_INET_ESP" = "y" -o \
       "$CONFIG_INET_ESP" = "m" -o \
       "$CONFIG_INET6_ESP" = "y" -o \
       "$CONFIG_INET6_ESP" = "m" ]; then
    define_bool CONFIG_CRYPTO_DES y
  else
    tristate       '  DES and Triple DES EDE cipher algorithms' CONFIG_CRYPTO_DES
  fi
  tristate       '  Blowfish cipher algorithm' CONFIG_CRYPTO_BLOWFISH
  tristate       '  Twofish cipher algorithm' CONFIG_CRYPTO_TWOFISH
  tristate       '  Serpent cipher algorithm' CONFIG_CRYPTO_SERPENT
  tristate       '  AES cipher algorithms' CONFIG_CRYPTO_AES
  tristate       '  CAST5 (CAST-128) cipher algorithm' CONFIG_CRYPTO_CAST5
  tristate       '  CAST6 (CAST-256) cipher algorithm' CONFIG_CRYPTO_CAST6
  tristate       '  TEA and XTEA cipher algorithms' CONFIG_CRYPTO_TEA
  tristate       '  Khazad cipher algorithm' CONFIG_CRYPTO_KHAZAD
  tristate       '  Anubis cipher algorithm' CONFIG_CRYPTO_ANUBIS
  tristate       '  ARC4 cipher algorithm' CONFIG_CRYPTO_ARC4
  if [ "$CONFIG_INET_IPCOMP" = "y" -o \
       "$CONFIG_INET_IPCOMP" = "m" -o \
       "$CONFIG_INET6_IPCOMP" = "y" -o \
       "$CONFIG_INET6_IPCOMP" = "m" ]; then
    define_bool CONFIG_CRYPTO_DEFLATE y
  else
    tristate       '  Deflate compression algorithm' CONFIG_CRYPTO_DEFLATE
  fi
  tristate       '  Michael MIC keyed digest algorithm' CONFIG_CRYPTO_MICHAEL_MIC
  tristate       '  Testing module' CONFIG_CRYPTO_TEST
  
  tristate	'Support for VIA PadLock ACE' CONFIG_CRYPTO_DEV_PADLOCK
  if [ "$CONFIG_CRYPTO_DEV_PADLOCK" = "y" -o \
       "$CONFIG_CRYPTO_DEV_PADLOCK" = "m" ]; then
    bool	'  Support for AES in VIA PadLock' CONFIG_CRYPTO_DEV_PADLOCK_AES
  fi
  
  
 
	 
  tristate	'Support for Infineon DEU' CONFIG_CRYPTO_DEV_DEU
  if [ "$CONFIG_CRYPTO_DEV_DEU" = "y" -o \
       "$CONFIG_CRYPTO_DEV_DEU" = "m" ]; then
    
     choice 'DEU type' \
	"INCAIP1	CONFIG_CRYPTO_DEV_INCAIP1 \
	 INCAIP2	CONFIG_CRYPTO_DEV_INCAIP2 \
	 Danube	CONFIG_CRYPTO_DEV_DANUBE"  INCAIP1
    
    if [ "$CONFIG_CRYPTO_DEV_INCAIP1" = "y" ]; then
      bool	'  Support for DES/3DES in Infineon IncaIP1 DEU' CONFIG_CRYPTO_DEV_INCAIP1_DES
      bool	'  Support for AES in Infineon IncaIP1 DEU' CONFIG_CRYPTO_DEV_INCAIP1_AES
    fi
    if [ "$CONFIG_CRYPTO_DEV_INCAIP2" = "y" ]; then
      bool	'  Support for DES/3DES in Infineon IncaIP2 DEU' CONFIG_CRYPTO_DEV_INCAIP2_DES
      bool	'  Support for AES in Infineon IncaIP2 DEU' CONFIG_CRYPTO_DEV_INCAIP2_AES
      bool	'  Support for SHA1 in Infineon IncaIP2 DEU' CONFIG_CRYPTO_DEV_INCAIP2_SHA1
      bool	'  Support for MD5 in Infineon IncaIP2 DEU' CONFIG_CRYPTO_DEV_INCAIP2_MD5
    fi
    if [ "$CONFIG_CRYPTO_DEV_DANUBE" = "y" ]; then
      bool	'  Support for DES/3DES in Infineon Danube DEU' CONFIG_CRYPTO_DEV_DANUBE_DES
      bool	'  Support for AES in Infineon Danube DEU' CONFIG_CRYPTO_DEV_DANUBE_AES
      bool	'  Support for SHA1 in Infineon Danube DEU' CONFIG_CRYPTO_DEV_DANUBE_SHA1
      bool	'  Support for MD5 in Infineon Danube DEU' CONFIG_CRYPTO_DEV_DANUBE_MD5
      bool	'  Use DMA for DEU' CONFIG_CRYPTO_DEV_DANUBE_DMA
    fi
  fi
fi

endmenu
```

## opensource/isdn4k-utils/scripts/config.in
```kconfig
#
# $Id: config.in,v 1.36 2000/06/20 10:16:16 keil Exp $
#
# The whole configuration stuff is borrowed from the kernel
# configuration.
#
# For a description of the syntax of this configuration file,
# see the Menuconfig script.
#
CONFIG_HASX11=n
if [ "`type -p xmkmf`" != "" ]; then
CONFIG_HASX11=y
fi
mainmenu_name "isdn4k-utils Configuration"

mainmenu_option next_comment
comment 'Code maturity level options'
bool 'Prompt for development and/or incomplete code' CONFIG_EXPERIMENTAL
endmenu
mainmenu_option next_comment
comment 'General configuration'
comment 'Build options'
dep_bool 'Build programs which need X11 installed' CONFIG_BUILDX11 $CONFIG_HASX11
string 'Kernel source directory' CONFIG_KERNELDIR
comment 'Destination directories'
string 'Directory to install binaries' CONFIG_BINDIR
string 'Directory to install admin binaries' CONFIG_SBINDIR
string 'Directory to install man pages' CONFIG_MANDIR
comment 'Runtime defaults'
string 'Write .pid files here' CONFIG_RUNDIR
string 'Write lock files here' CONFIG_LOCKDIR
string 'Prefix for the lock file' CONFIG_LOCKFILE
string 'General configuration directory' CONFIG_I4LCONFDIR
string 'Global configuration file' CONFIG_CONFFILE
string 'Global phone number file' CONFIG_CALLERIDFILE
string 'User configuration file' CONFIG_USERCONFFILE
comment 'Configuration library options'
string 'Your country code' CONFIG_COUNTRYCODE
string 'Your area code' CONFIG_AREACODE
string 'Default country prefix' CONFIG_COUNTRY_PREFIX
string 'Default area prefix' CONFIG_AREA_PREFIX
string 'Directory to install fixed data' CONFIG_DATADIR
#choice 'Database for area codes' \
#        "Areacode CONFIG_LIB_AREACODE \
#        Avon CONFIG_LIB_AVON"
#if [ "$CONFIG_LIB_AVON" = "y" ]; then
#	string 'Directory to install avon database' CONFIG_AVON_DATA
#fi
endmenu
mainmenu_option nextcomment
comment 'Runtime configuration tools'
bool 'isdnctrl' CONFIG_ISDNCTRL
if [ "$CONFIG_ISDNCTRL" = "y" ]; then
#	bool 'Enable isdnctrl debug-option' CONFIG_ISDNCTRL_DEBUG
	bool 'Enable configfile-option (uses dbm lib)' CONFIG_ISDNCTRL_CONF
	bool 'Enable timru-controls' CONFIG_ISDNCTRL_TIMRU
	if [ "$CONFIG_EXPERIMENTAL" = "y" ]; then
		bool 'Enable udp-info-controls' CONFIG_ISDNCTRL_DWABC_UDP_INFO
	fi
fi
bool 'iprofd' CONFIG_IPROFD
bool 'divertctrl' CONFIG_DIVERTCTRL
endmenu
mainmenu_option nextcomment
comment 'Card configuration tools'
bool 'hisaxctrl' CONFIG_HISAXCTRL
bool 'icnctrl' CONFIG_ICNCTRL
if [ "$CONFIG_ICNCTRL" = "y" ]; then
	bool 'Enable icnctrl debug-option' CONFIG_ICNCTRL_DEBUG
fi
bool 'pcbitctl' CONFIG_PCBITCTL
bool 'avmcapictrl / capiinit' CONFIG_AVMCAPICTRL
if [ -f $CONFIG_KERNELDIR/drivers/isdn/act2000/act2000.h ] ; then
	bool 'actctrl' CONFIG_ACTCTRL
fi
bool 'eiconctrl' CONFIG_EICONCTRL
if [ "$CONFIG_EXPERIMENTAL" = "y" ]; then
	bool 'loopctrl' CONFIG_LOOPCTRL
	if [ "$CONFIG_LOOPCTRL" = "y" ]; then
		# string 'Sourcedir of isdnloop module' CONFIG_LOOPCTRL_LOOPDIR
		bool 'Enable loopctrl debug-option' CONFIG_LOOPCTRL_DEBUG
	fi
fi
endmenu
mainmenu_option nextcomment
comment 'Tools for monitoring activity'
bool 'imon' CONFIG_IMON
bool 'imontty' CONFIG_IMONTTY
bool 'isdnlog' CONFIG_ISDNLOG
if [ "$CONFIG_ISDNLOG" = "y" ] ; then
	source isdnlog/.Config.in
fi
comment ''
bool 'ipppstats' CONFIG_IPPPSTATS
dep_bool 'xisdnload' CONFIG_XISDNLOAD $CONFIG_BUILDX11
dep_bool 'xmonisdn' CONFIG_XMONISDN $CONFIG_BUILDX11
if [ "$CONFIG_XMONISDN" = "y" ] ; then
	mainmenu_option nextcomment
	comment 'Options for xmonisdn'
	string 'NetUP command' CONFIG_XMONISDN_UPCMD
	string 'NetDOWN command' CONFIG_XMONISDN_DOWNCMD
	endmenu
fi
endmenu
mainmenu_option nextcomment
comment 'Applications'
bool 'vbox' CONFIG_VBOX
if [ "$CONFIG_VBOX" = "y" ]; then
	source vbox/.Config.in
fi
bool 'ipppd' CONFIG_IPPPD
if [ "$CONFIG_IPPPD" = "y" ]; then
	source ipppd/.Config.in
fi
if [ "$CONFIG_EXPERIMENTAL" = "y" ]; then
	bool 'capifax' CONFIG_CAPIFAX
	bool 'rcapid' CONFIG_RCAPID
	bool 'pppdcapiplugin' CONFIG_PPPDCAPIPLUGIN
fi
if [ "$CONFIG_EXPERIMENTAL" = "y" ]; then
	bool 'eurofile' CONFIG_EUROFILE
		source eurofile/.Config.in
fi
endmenu
mainmenu_option nextcomment
comment 'Documentation'
bool 'Install generic pages' CONFIG_GENMAN
bool 'Generate FAQ' CONFIG_FAQ
if [ "$CONFIG_FAQ" = "y" ]; then
	string 'Directory to install FAQ' CONFIG_FAQDIR
fi
endmenu
```

## opensource/mtd/drivers/mtd/nand/Kconfig
```kconfig
# drivers/mtd/nand/Kconfig
# $Id: Kconfig,v 1.9 2004/03/18 09:30:36 gleixner Exp $

menu "NAND Flash Device Drivers"
	depends on MTD!=n

config MTD_NAND
	tristate "NAND Device Support"
	depends on MTD
	help
	  This enables support for accessing all type of NAND flash
	  devices with an 8-bit data bus interface. For further 
	  information see www.linux-mtd.infradead.org/tech/nand.html.

config MTD_NAND_VERIFY_WRITE
	bool "Verify NAND page writes"
	depends on MTD_NAND
	help
	  This adds an extra check when data is written to the flash. The
	  NAND flash device internally checks only bits transitioning
	  from 1 to 0. There is a rare possibility that even though the
	  device thinks the write was successful, a bit could have been
	  flipped accidentaly due to device wear or something else.

config MTD_NAND_AUTCPU12
	tristate "SmartMediaCard on autronix autcpu12 board"
	depends on ARM && MTD_NAND && ARCH_AUTCPU12
	help
	  This enables the driver for the autronix autcpu12 board to 
	  access the SmartMediaCard.

config MTD_NAND_EDB7312
	tristate "Support for Cirrus Logic EBD7312 evaluation board"
	depends on ARM && MTD_NAND && ARCH_EDB7312
	help
	  This enables the driver for the Cirrus Logic EBD7312 evaluation 
	  board to access the onboard NAND Flash.

config MTD_NAND_SPIA
	tristate "NAND Flash device on SPIA board"
	depends on ARM && ARCH_P720T && MTD_NAND
	help
	  If you had to ask, you don't have one. Say 'N'.

config MTD_NAND_TOTO
	tristate "NAND Flash device on TOTO board"
	depends on ARM && ARCH_OMAP && MTD_NAND
	help
	  Support for NAND flash on Texas Instruments Toto platform.

config MTD_NAND_IDS
	tristate
	default y if MTD_NAND = y || MTD_DOC2000 = y || MTD_DOC2001 = y || MTD_DOC2001PLUS = y
	default m if MTD_NAND = m || MTD_DOC2000 = m || MTD_DOC2001 = m || MTD_DOC2001PLUS = m

config MTD_NAND_TX4925NDFMC
	tristate "SmartMedia Card on Toshiba RBTX4925 reference board"
	depends on TOSHIBA_RBTX4925 && MTD_NAND && TOSHIBA_RBTX4925_MPLEX_NAND
	help
	  This enables the driver for the NAND flash device found on the
	  Toshiba RBTX4925 reference board, which is a SmartMediaCard.

config MTD_NAND_TX4938NDFMC
	tristate "NAND Flash device on Toshiba RBTX4938 reference board"
	depends on TOSHIBA_RBTX4938 && MTD_NAND && TOSHIBA_RBTX4938_MPLEX_NAND 
	help
	  This enables the driver for the NAND flash device found on the
	  Toshiba RBTX4938 reference board.

config MTD_NAND_AU1550
	tristate "Au1550 NAND support"
	depends on SOC_AU1550 && MTD_NAND
	help
	  This enables the driver for the NAND flash controller on the
	  AMD/Alchemy 1550 SOC.

config MTD_NAND_PPCHAMELEONEVB
	tristate "NAND Flash device on PPChameleonEVB board"
	depends on PPCHAMELEONEVB && MTD_NAND
	help
	  This enables the NAND flash driver on the PPChameleon EVB Board.	
endmenu
```

## opensource/mtd/fs/Kconfig
```kconfig
config JFFS_FS
	tristate "Journalling Flash File System (JFFS) support"
	depends on MTD
	help
	  JFFS is the Journaling Flash File System developed by Axis
	  Communications in Sweden, aimed at providing a crash/powerdown-safe
	  file system for disk-less embedded devices. Further information is
	  available at (<http://developer.axis.com/software/jffs/>).

config JFFS_FS_VERBOSE
	int "JFFS debugging verbosity (0 = quiet, 3 = noisy)"
	depends on JFFS_FS
	default "0"
	help
	  Determines the verbosity level of the JFFS debugging messages.

config JFFS_PROC_FS
	bool "JFFS stats available in /proc filesystem"
	depends on JFFS_FS
	help
	  Enabling this option will cause statistics from mounted JFFS file systems
	  to be made available to the user in the /proc/fs/jffs/ directory.

config JFFS2_FS
	tristate "Journalling Flash File System v2 (JFFS2) support"
	depends on MTD
	help
	  JFFS2 is the second generation of the Journalling Flash File System
	  for use on diskless embedded devices. It provides improved wear
	  levelling, compression and support for hard links. You cannot use
	  this on normal block devices, only on 'MTD' devices.

	  Further information on the design and implementation of JFFS2 is
	  available at <http://sources.redhat.com/jffs2/>.

config JFFS2_FS_DEBUG
	int "JFFS2 debugging verbosity (0 = quiet, 2 = noisy)"
	depends on JFFS2_FS
	default "0"
	---help---
	  This controls the amount of debugging messages produced by the JFFS2
	  code. Set it to zero for use in production systems. For evaluation,
	  testing and debugging, it's advisable to set it to one. This will
	  enable a few assertions and will print debugging messages at the
	  KERN_DEBUG loglevel, where they won't normally be visible. Level 2
	  is unlikely to be useful - it enables extra debugging in certain
	  areas which at one point needed debugging, but when the bugs were
	  located and fixed, the detailed messages were relegated to level 2.

	  If reporting bugs, please try to have available a full dump of the
	  messages at debug level 1 while the misbehaviour was occurring.

config JFFS2_FS_NAND
	bool "JFFS2 support for NAND flash (EXPERIMENTAL)"
	depends on JFFS2_FS && EXPERIMENTAL
	default n
	---help---
	  This enables the experimental support for NAND flash in JFFS2. NAND
	  is a newer type of flash chip design than the traditional NOR flash,
	  with higher density but a handful of characteristics which make it
	  more interesting for the file system to use. Support for NAND flash
	  is not yet complete and may corrupt data. For further information,
	  including a link to the mailing list where details of the remaining
	  work to be completed for NAND flash support can be found, see the 
	  JFFS2 web site at <http://sources.redhat.com/jffs2>.

	  Say 'N' unless you have NAND flash and you are willing to test and
	  develop JFFS2 support for it.
```

## opensource/mtd/fs/jffs2/defconfig
```kconfig
# $Id: defconfig,v 1.1 2003/05/27 09:35:22 dwmw2 Exp $

CONFIG_JFFS2_FS=m
ifdef NONAND
CONFIG_JFFS2_FS_NAND=n
else
CONFIG_JFFS2_FS_NAND=y
endif
```
